## drivers/serial/Kconfig.sam0
```kconfig
# Atmel SAM SERCOM configuration options

# Copyright (c) 2017 Google LLC.
# SPDX-License-Identifier: Apache-2.0

config UART_SAM0
	bool "Atmel SAM0 series SERCOM USART driver"
	default y
	depends on DT_HAS_ATMEL_SAM0_UART_ENABLED
	select PINCTRL
	select SERIAL_HAS_DRIVER
	select SERIAL_SUPPORT_INTERRUPT
	select SERIAL_SUPPORT_ASYNC if DT_HAS_ATMEL_SAM0_DMAC_ENABLED
	help
	  This option enables the SERCOMx USART driver for Atmel SAM0 MCUs.

config UART_SAM0_ASYNC
	bool "Async UART support for Atmel SAM0 series."
	depends on DMA_SAM0
	depends on UART_SAM0
	depends on UART_ASYNC_API

config UART_SAM0_ASYNC_RX_CONTINUOUS
	bool "Keep the RX DMA running between timeout ticks"
	depends on UART_SAM0_ASYNC
	help
	  In the default async RX mode the driver stops the DMA channel on
	  every timeout tick and re-arms it from the next RXC interrupt, which
	  loses bytes at high baud rates because the SERCOM has no RX FIFO.
	  With this option the DMA is paused only long enough to read its
	  progress and restarted at once; received bytes are delivered to the
	  application every timeout/4 while reception is enabled. Costs one
	  work item per tick.
```
